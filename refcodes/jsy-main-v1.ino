#include <WiFi.h>
#include <PubSubClient.h>
#include <ArduinoJson.h>
#include <SPI.h>
#include <TFT_eSPI.h>
#include <time.h>
//#include "PowerGardLogo.h"
//const unsigned short powerGardLogo[9900] PROGMEM={
  // 'Logo_SplashDisplay', 150x150px
const unsigned short  powerGardLogo[10500] PROGMEM={
0x18C3, 0x18C3, 0x18C3, 0x18C3, 0x18C3, 0x18C3, 0x18C3, 0x18C3, 0x18C3, 0x18C3, 0x18C3, 0x18C3, 0x18C3, 0x18C3, 0x18C3, 0x18C3,   // 0x0010 (16) pixels
0x18C3, 0x18C3, 0x18C3, 0x18C3, 0x18C3, 0x18C3, 0x18C3, 0x18C3, 0x18C3, 0x18C3, 0x18C3, 0x18C3, 0x18C3, 0x18C3, 0x18C3, 0x18C3,   // 0x0020 (32) pixels
0x18C3, 0x18C3, 0x18C3, 0x18C3, 0x18C3, 0x18C3, 0x18C3, 0x18C3, 0x18C3, 0x18C3, 0x18C3, 0x18C3, 0x18C3, 0x18C3, 0x18C3, 0x18C3,   // 0x0030 (48) pixels
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0x18C3, 0x18C3, 0x18C3, 0x18C3
};



#define SMOOTH_FONT
//+++++IMPORTANTE++++++++++++++++Colocar na pasta do sketch o arquivo User_Setup.h que é o driver do display

// WiFi and MQTT settings
#define WIFI_SSID "SFX2"
#define WIFI_PASSWORD "SUESE8069"
#define MQTT_SERVER "broker.emqx.io"
#define MQTT_USERNAME "emqx"
#define MQTT_PASSWORD "public"
#define MQTT_PORT 1883
#define MQTT_TOPIC "powergard_dataset"

// Button pins
#define BUTTON_UP_PIN 12    // GPIO pin for UP button
#define BUTTON_DOWN_PIN 14  // GPIO pin for DOWN button
#define DEBOUNCE_TIME 200   // Button debounce time in ms

// Display colors
#define COLOR_BACKGROUND TFT_BLACK
#define COLOR_TEXT TFT_WHITE
#define COLOR_WARNING TFT_RED
#define COLOR_OK TFT_GREEN
#define COLOR_TITLE TFT_CYAN
#define COLOR_VOLTAGE TFT_YELLOW
#define COLOR_SUBTITLE TFT_ORANGE
#define COLOR_INACTIVE TFT_DARKGREY
#define COLOR_BAR_BG TFT_NAVY
#define COLOR_ALARM_BG TFT_RED
#define COLOR_GAS_ALARM_BG TFT_GREEN

// NTP Settings
#define NTP_SERVER "pool.ntp.org"
#define GMT_OFFSET_SEC -3 * 3600  // GMT-3 for Brazil
#define DAYLIGHT_OFFSET_SEC 0

// Display dimensions
#define SCREEN_WIDTH 240
#define SCREEN_HEIGHT 320
#define BAR_WIDTH 120
#define TEXT_HEIGHT 20
#define TOTAL_PAGES 5  // Total number of regular pages
#define TOTAL_ALARM_PAGES 3 // Total number of alarm pages

// Alarm thresholds
#define VOLTAGE_LOW_THRESHOLD 100.0
#define VOLTAGE_HIGH_THRESHOLD 135.0
#define PHASE_LOSS_THRESHOLD 10.0
#define GAS_ALARM_THRESHOLD 8 // Gas alarm threshold (ppm)

// Create instances
TFT_eSPI tft = TFT_eSPI();
WiFiClient espClient;
PubSubClient client(espClient);

// Sensor data structure
struct SensorData {
  // Legacy data
  int gasmon = 0;
  bool overSub = false;
  bool faseStatus = false;
  bool activeStatus = false;
  int levCx1 = 0;  // Water level %
  int levCx2 = 0;  // Water flow L/min
  int levCs1 = 0;  // Additional sensor
  
  // JSY-MK-333 Phase data
  struct PhaseData {
    float voltage = 0;
    float current = 0;
    float power = 0;
    float energy = 0;
    float powerFactor = 0;
  };
  
  PhaseData phase1;
  PhaseData phase2;
  PhaseData phase3;
  
  // System data
  unsigned long lastUpdate = 0;
  char timeStr[20];
  int wifiStrength;
} sensorData;

// Alarm states
struct AlarmStates {
  bool voltageAlarm = false;
  bool phaseAlarm = false;
  bool gasAlarm = false;
  
  // Store specific alarm information
  struct VoltageAlarmInfo {
    bool phase1High = false;
    bool phase1Low = false;
    bool phase2High = false;
    bool phase2Low = false;
    bool phase3High = false;
    bool phase3Low = false;
  } voltageInfo;
  
  struct PhaseAlarmInfo {
    bool phase1Loss = false;
    bool phase2Loss = false;
    bool phase3Loss = false;
  } phaseInfo;
} alarmStates;

// Navigation variables
int currentPage = 0;
bool lastUpState = HIGH;
bool lastDownState = HIGH;
unsigned long lastUpDebounceTime = 0;
unsigned long lastDownDebounceTime = 0;
bool needsRefresh = true;

// Active alarm variables
bool alarmActive = false;
int activeAlarmPage = -1; // -1 means no alarm page is active
unsigned long lastAlarmCheck = 0;
const unsigned long ALARM_CHECK_INTERVAL = 1000; // Check alarms every 1 second

// Serial command buffer
String serialCmd = "";
bool serialCmdComplete = false;

// Function prototypes
void updateDisplay();
void updateTimeAndWifi();
void drawBorder();
void callback(char* topic, byte* payload, unsigned int length);
void reconnect();
void drawLayout();
void handleButtons();
void handleSerialCommands();
void processSerialCommand();
void drawPage1();
void drawPage2();
void drawPage3();
void drawPage4();
void drawPage5();
void drawPageIndicator();
void drawHeader();
void showHelp();
void simulateData(bool randomizeData);
void checkAlarms();
void drawVoltageAlarmPage();
void drawPhaseFailAlarmPage();
void drawGasAlarmPage();
void resetAlarms();

void setup() {
  Serial.begin(115200);
  randomSeed(micros());
  
  // Initialize button pins
  pinMode(BUTTON_UP_PIN, INPUT_PULLUP);
  pinMode(BUTTON_DOWN_PIN, INPUT_PULLUP);
  
  // Initialize display
  tft.init();
  tft.setRotation(0);  // Portrait mode
  tft.fillScreen(COLOR_BACKGROUND);
  
  // --------- LOGO POWERGARD COMO BITMAP -----------
  int logoX = (SCREEN_WIDTH - 100) / 2;  // Centraliza logo de 100px
  int logoY = 60;
  
  // Desenha o bitmap do logo
  tft.pushImage(logoX, logoY, 100, 100, powerGardLogo);
  
  // Texto "PowerGard Monitor"
  tft.setTextColor(TFT_WHITE, COLOR_BACKGROUND);
  tft.setTextSize(2);
  tft.setCursor((SCREEN_WIDTH - 200) / 2, 180);
  tft.println("PowerGard Monitor");
  
  // Print welcome message and serial command instructions
  Serial.println("\n\nPowerGard Monitor System");
  Serial.println("Serial Commands Available:");
  showHelp();
  
  // Setup WiFi
  tft.setTextColor(COLOR_TEXT);
  tft.drawString("Conectando ao WiFi...", 10, 240, 2);
  
  WiFi.begin(WIFI_SSID, WIFI_PASSWORD);
  
  // Exibe pontos animados durante a conexão
  int dots = 0;
  while (WiFi.status() != WL_CONNECTED) {
    delay(500);
    Serial.print(".");
    dots++;
    if (dots > 5) {
      tft.fillRect(10, 260, 220, 20, COLOR_BACKGROUND);
      dots = 0;
    }
    tft.drawString(".", 10 + (dots * 10), 260, 2);
     }
  
  // Setup MQTT
  client.setServer(MQTT_SERVER, MQTT_PORT);
  client.setCallback(callback);
  
  // Setup NTP
  configTime(GMT_OFFSET_SEC, DAYLIGHT_OFFSET_SEC, NTP_SERVER);
  
  // Initial display layout
  delay(4000);  // Mantém a splash screen visível por 2 segundos
  drawLayout();
  }

void loop() {
  if (!client.connected()) {
    reconnect();
  }
  client.loop();
  
  // Check for alarms periodically
  unsigned long currentMillis = millis();
  if (currentMillis - lastAlarmCheck > ALARM_CHECK_INTERVAL) {
    checkAlarms();
    lastAlarmCheck = currentMillis;
  }
  
  // Check physical buttons
  handleButtons();
  
  // Check serial commands
  handleSerialCommands();
  
  if (needsRefresh) {
    updateDisplay();
    needsRefresh = false;
  }
  
  // Update time and wifi indicator periodically
  static unsigned long lastTimeUpdate = 0;
  if (millis() - lastTimeUpdate > 1000) {
    updateTimeAndWifi();
    drawHeader();
    lastTimeUpdate = millis();
  }
  
  delay(50);
}

void checkAlarms() {
  bool previousAlarmState = alarmActive;
  int previousActiveAlarm = activeAlarmPage;
  
  // Reset alarm states
  alarmStates.voltageAlarm = false;
  alarmStates.phaseAlarm = false;
  alarmStates.gasAlarm = false;
  
  // Fill alarm info with current values
  
  // Check for voltage alarms
  alarmStates.voltageInfo.phase1High = sensorData.phase1.voltage > VOLTAGE_HIGH_THRESHOLD;
  alarmStates.voltageInfo.phase1Low = sensorData.phase1.voltage < VOLTAGE_LOW_THRESHOLD && sensorData.phase1.voltage >= PHASE_LOSS_THRESHOLD;
  alarmStates.voltageInfo.phase2High = sensorData.phase2.voltage > VOLTAGE_HIGH_THRESHOLD;
  alarmStates.voltageInfo.phase2Low = sensorData.phase2.voltage < VOLTAGE_LOW_THRESHOLD && sensorData.phase2.voltage >= PHASE_LOSS_THRESHOLD;
  alarmStates.voltageInfo.phase3High = sensorData.phase3.voltage > VOLTAGE_HIGH_THRESHOLD;
  alarmStates.voltageInfo.phase3Low = sensorData.phase3.voltage < VOLTAGE_LOW_THRESHOLD && sensorData.phase3.voltage >= PHASE_LOSS_THRESHOLD;
  
  // Check for phase loss
  alarmStates.phaseInfo.phase1Loss = sensorData.phase1.voltage < PHASE_LOSS_THRESHOLD;
  alarmStates.phaseInfo.phase2Loss = sensorData.phase2.voltage < PHASE_LOSS_THRESHOLD;
  alarmStates.phaseInfo.phase3Loss = sensorData.phase3.voltage < PHASE_LOSS_THRESHOLD;
  
  // Set main alarm flags
  alarmStates.voltageAlarm = alarmStates.voltageInfo.phase1High || alarmStates.voltageInfo.phase1Low || 
                            alarmStates.voltageInfo.phase2High || alarmStates.voltageInfo.phase2Low || 
                            alarmStates.voltageInfo.phase3High || alarmStates.voltageInfo.phase3Low;
                            
  alarmStates.phaseAlarm = alarmStates.phaseInfo.phase1Loss || 
                          alarmStates.phaseInfo.phase2Loss || 
                          alarmStates.phaseInfo.phase3Loss;
                          
  alarmStates.gasAlarm = sensorData.gasmon > GAS_ALARM_THRESHOLD;
  
  // Determine which alarm to show (priority: phase loss > voltage > gas)
  if (alarmStates.phaseAlarm) {
    alarmActive = true;
    activeAlarmPage = 0; // Phase alarm page
  } else if (alarmStates.voltageAlarm) {
    alarmActive = true;
    activeAlarmPage = 1; // Voltage alarm page
  } else if (alarmStates.gasAlarm) {
    alarmActive = true;
    activeAlarmPage = 2; // Gas alarm page
  } else {
    alarmActive = false;
    activeAlarmPage = -1;
  }
  
  // If alarm state or active alarm changed, refresh display
  if (previousAlarmState != alarmActive || previousActiveAlarm != activeAlarmPage) {
    needsRefresh = true;
    
    if (alarmActive) {
      Serial.print("ALARME ATIVO: ");
      switch (activeAlarmPage) {
        case 0:
          Serial.println("Falha de Fase");
          break;
        case 1:
          Serial.println("Tensão Anormal");
          break;
        case 2:
          Serial.println("Vazamento de Gás");
          break;
      }
    } else if (previousAlarmState) {
      Serial.println("Alarmes normalizados");
    }
  }
}

void resetAlarms() {
  alarmActive = false;
  activeAlarmPage = -1;
  needsRefresh = true;
}

void handleSerialCommands() {
  // Process any incoming serial data
  while (Serial.available() > 0) {
    char inChar = (char)Serial.read();
    
    // Process the character
    if (inChar == '\n' || inChar == '\r') {
      if (serialCmd.length() > 0) {
        serialCmdComplete = true;
      }
    } else {
      serialCmd += inChar;
    }
  }
  
  // Process the completed command
  if (serialCmdComplete) {
    processSerialCommand();
    serialCmd = "";
    serialCmdComplete = false;
  }
}

void processSerialCommand() {
  serialCmd.trim();
  
  // Convert to lowercase for case-insensitive commands
  serialCmd.toLowerCase();
  
  if (serialCmd == "help" || serialCmd == "h") {
    showHelp();
  } 
  else if (serialCmd == "next" || serialCmd == "n") {
    // Go to next page (only if no alarm is active)
    if (!alarmActive) {
      currentPage = (currentPage + 1) % TOTAL_PAGES;
      Serial.print("Showing page ");
      Serial.print(currentPage + 1);
      Serial.print(" of ");
      Serial.println(TOTAL_PAGES);
      needsRefresh = true;
    } else {
      Serial.println("Cannot change page while alarm is active");
    }
  }
  else if (serialCmd == "prev" || serialCmd == "p") {
    // Go to previous page (only if no alarm is active)
    if (!alarmActive) {
      currentPage = (currentPage > 0) ? currentPage - 1 : TOTAL_PAGES - 1;
      Serial.print("Showing page ");
      Serial.print(currentPage + 1);
      Serial.print(" of ");
      Serial.println(TOTAL_PAGES);
      needsRefresh = true;
    } else {
      Serial.println("Cannot change page while alarm is active");
    }
  }
  else if (serialCmd.startsWith("page ")) {
    // Go to specific page, e.g., "page 1" (only if no alarm is active)
    if (!alarmActive) {
      int page = serialCmd.substring(5).toInt();
      if (page >= 1 && page <= TOTAL_PAGES) {
        currentPage = page - 1;
        Serial.print("Showing page ");
        Serial.println(page);
        needsRefresh = true;
      } else {
        Serial.print("Invalid page number. Please enter 1-");
        Serial.println(TOTAL_PAGES);
      }
    } else {
      Serial.println("Cannot change page while alarm is active");
    }
  }
  else if (serialCmd == "status") {
    // Show system status
    Serial.println("\nSystem Status:");
    Serial.print("Current Page: ");
    if (alarmActive) {
      Serial.print("ALARM - ");
      switch (activeAlarmPage) {
        case 0: Serial.println("Phase Failure"); break;
        case 1: Serial.println("Voltage Abnormal"); break;
        case 2: Serial.println("Gas Leak"); break;
      }
    } else {
      Serial.print(currentPage + 1);
      Serial.print("/");
      Serial.println(TOTAL_PAGES);
    }
    Serial.print("WiFi RSSI: ");
    Serial.print(WiFi.RSSI());
    Serial.println(" dBm");
    Serial.print("MQTT Status: ");
    Serial.println(client.connected() ? "Connected" : "Disconnected");
    
    // Print alarm states
    Serial.println("\nAlarm States:");
    Serial.print("Voltage Alarm: ");
    Serial.println(alarmStates.voltageAlarm ? "ACTIVE" : "Inactive");
    Serial.print("Phase Alarm: ");
    Serial.println(alarmStates.phaseAlarm ? "ACTIVE" : "Inactive");
    Serial.print("Gas Alarm: ");
    Serial.println(alarmStates.gasAlarm ? "ACTIVE" : "Inactive");
  }
  else if (serialCmd == "testdata") {
    // Generate test data
    simulateData(true);
    Serial.println("Generated random test data");
    needsRefresh = true;
  }
  else if (serialCmd == "zerodata") {
    // Reset all data to zero
    simulateData(false);
    Serial.println("Reset all data to zero");
    needsRefresh = true;
  }
  else if (serialCmd == "testvoltage") {
    // Generate voltage alarm data
    simulateData(false);
    sensorData.phase1.voltage = 90.0; // Under voltage
    sensorData.phase2.voltage = 140.0; // Over voltage
    sensorData.phase3.voltage = 120.0; // Normal voltage
    Serial.println("Generated voltage alarm test data");
    needsRefresh = true;
  }
  else if (serialCmd == "testphase") {
    // Generate phase loss alarm data
    simulateData(false);
    sensorData.phase1.voltage = 0.0; // Phase loss
    sensorData.phase2.voltage = 120.0; // Normal
    sensorData.phase3.voltage = 5.0; // Phase loss
    Serial.println("Generated phase loss test data");
    needsRefresh = true;
  }
  else if (serialCmd == "testgas") {
    // Generate gas alarm data
    simulateData(false);
    sensorData.gasmon = 12; // Gas alarm
    Serial.println("Generated gas alarm test data");
    needsRefresh = true;
  }
  else if (serialCmd == "resetalarms") {
    // Reset all alarms (for testing purposes)
    resetAlarms();
    Serial.println("Reset all alarms");
  }
  else if (serialCmd == "refresh" || serialCmd == "r") {
    // Force refresh display
    needsRefresh = true;
    Serial.println("Refreshing display");
  }
  else {
    Serial.print("Unknown command: '");
    Serial.print(serialCmd);
    Serial.println("'. Type 'help' for available commands.");
  }
}

void showHelp() {
  Serial.println("\nAvailable Commands:");
  Serial.println("  help or h       - Show this help");
  Serial.println("  next or n       - Go to next page");
  Serial.println("  prev or p       - Go to previous page");
  Serial.println("  page <number>   - Go to specific page (1-5)");
  Serial.println("  status          - Show system status");
  Serial.println("  testdata        - Generate random test data");
  Serial.println("  zerodata        - Reset all data to zero");
  Serial.println("  testvoltage     - Test voltage alarm");
  Serial.println("  testphase       - Test phase loss alarm");
  Serial.println("  testgas         - Test gas alarm");
  Serial.println("  resetalarms     - Reset all active alarms");
  Serial.println("  refresh or r    - Refresh display");
  Serial.println("");
}

void simulateData(bool randomizeData) {
  if (randomizeData) {
    // Generate random test data
    sensorData.gasmon = random(0, 15);
    sensorData.overSub = random(0, 2);
    sensorData.faseStatus = random(0, 2);
    sensorData.activeStatus = random(0, 2);
    sensorData.levCx1 = random(0, 101);  // Water level 0-100%
    sensorData.levCx2 = random(0, 30);   // Water flow 0-30 L/min
    sensorData.levCs1 = random(0, 100);
    
    // Phase 1
    sensorData.phase1.voltage = random(110, 131) + (random(0, 100) / 100.0);
    sensorData.phase1.current = random(5, 26) + (random(0, 100) / 100.0);
    sensorData.phase1.power = sensorData.phase1.voltage * sensorData.phase1.current;
    sensorData.phase1.energy = random(500, 2000) + (random(0, 100) / 100.0);
    sensorData.phase1.powerFactor = (random(80, 95) / 100.0);
    
    // Phase 2
    sensorData.phase2.voltage = random(110, 131) + (random(0, 100) / 100.0);
    sensorData.phase2.current = random(5, 26) + (random(0, 100) / 100.0);
    sensorData.phase2.power = sensorData.phase2.voltage * sensorData.phase2.current;
    sensorData.phase2.energy = random(500, 2000) + (random(0, 100) / 100.0);
    sensorData.phase2.powerFactor = (random(80, 95) / 100.0);
    
    // Phase 3
    sensorData.phase3.voltage = random(110, 131) + (random(0, 100) / 100.0);
    sensorData.phase3.current = random(5, 26) + (random(0, 100) / 100.0);
    sensorData.phase3.power = sensorData.phase3.voltage * sensorData.phase3.current;
    sensorData.phase3.energy = random(500, 2000) + (random(0, 100) / 100.0);
    sensorData.phase3.powerFactor = (random(80, 95) / 100.0);
  } else {
    // Set all data to zero
    sensorData.gasmon = 0;
    sensorData.overSub = false;
    sensorData.faseStatus = false;
    sensorData.activeStatus = false;
    sensorData.levCx1 = 0;
    sensorData.levCx2 = 0;
    sensorData.levCs1 = 0;
    
    // Phase 1
    sensorData.phase1.voltage = 0;
    sensorData.phase1.current = 0;
    sensorData.phase1.power = 0;
    sensorData.phase1.energy = 0;
    sensorData.phase1.powerFactor = 0;
    
    // Phase 2
    sensorData.phase2.voltage = 0;
    sensorData.phase2.current = 0;
    sensorData.phase2.power = 0;
    sensorData.phase2.energy = 0;
    sensorData.phase2.powerFactor = 0;
    
    // Phase 3
    sensorData.phase3.voltage = 0;
    sensorData.phase3.current = 0;
    sensorData.phase3.power = 0;
    sensorData.phase3.energy = 0;
    sensorData.phase3.powerFactor = 0;
  }
  
  sensorData.lastUpdate = millis();
}

void handleButtons() {
  // Read current button states
  bool upState = digitalRead(BUTTON_UP_PIN);
  bool downState = digitalRead(BUTTON_DOWN_PIN);
  unsigned long currentTime = millis();
  
  // Handle UP button with debounce
  if (upState != lastUpState && currentTime - lastUpDebounceTime > DEBOUNCE_TIME) {
    lastUpDebounceTime = currentTime;
    
    // Button is pressed (LOW when pressed with INPUT_PULLUP)
    if (upState == LOW) {
      // If alarm is active, pressing any button acknowledges it
      if (alarmActive) {
        // Just acknowledge the alarm, the system will show another alarm if present
        // or return to normal pages
        resetAlarms();
        Serial.println("Alarm acknowledged via UP button");
      } else {
        // Navigate to previous page
        currentPage = (currentPage > 0) ? currentPage - 1 : TOTAL_PAGES - 1;
        Serial.print("Button: Previous page - now showing page ");
        Serial.println(currentPage + 1);
        needsRefresh = true;
      }
    }
    
    lastUpState = upState;
  }
  
  // Handle DOWN button with debounce
  if (downState != lastDownState && currentTime - lastDownDebounceTime > DEBOUNCE_TIME) {
    lastDownDebounceTime = currentTime;
    
    // Button is pressed (LOW when pressed with INPUT_PULLUP)
    if (downState == LOW) {
      // If alarm is active, pressing any button acknowledges it
      if (alarmActive) {
        // Just acknowledge the alarm, the system will show another alarm if present
        // or return to normal pages
        resetAlarms();
        Serial.println("Alarm acknowledged via DOWN button");
      } else {
        // Navigate to next page
        currentPage = (currentPage + 1) % TOTAL_PAGES;
        Serial.print("Button: Next page - now showing page ");
        Serial.println(currentPage + 1);
        needsRefresh = true;
      }
    }
    
    lastDownState = downState;
  }
}

void callback(char* topic, byte* payload, unsigned int length) {
  StaticJsonDocument<768> doc;
  
  char buffer[length + 1];
  memcpy(buffer, payload, length);
  buffer[length] = '\0';
  
  Serial.print("Received MQTT message: ");
  Serial.println(buffer);
  
  DeserializationError error = deserializeJson(doc, buffer);
  
  if (!error) {
    // Extract legacy values
    sensorData.gasmon = doc["gm"] | 0;
    sensorData.overSub = doc["os"] | 0;
    sensorData.faseStatus = doc["fs"] | 0;
    sensorData.activeStatus = doc["as"] | 0;
    sensorData.levCx1 = doc["cx1"] | 0;
    sensorData.levCx2 = doc["cx2"] | 0;
    sensorData.levCs1 = doc["cs1"] | 0;
    
    // Extract Phase A (1) values
    JsonObject faseA = doc["fase1"];
    if (faseA) {
      sensorData.phase1.voltage = faseA["v"];
      sensorData.phase1.current = faseA["c"];
      sensorData.phase1.power = faseA["p"];
      sensorData.phase1.energy = faseA["e"];
      sensorData.phase1.powerFactor = faseA["pf"];
    }
    
    // Extract Phase B (2) values
    JsonObject faseB = doc["fase2"];
    if (faseB) {
      sensorData.phase2.voltage = faseB["v"];
      sensorData.phase2.current = faseB["c"];
      sensorData.phase2.power = faseB["p"];
      sensorData.phase2.energy = faseB["e"];
      sensorData.phase2.powerFactor = faseB["pf"];
    }
    
    // Extract Phase C (3) values
    JsonObject faseC = doc["fase3"];
    if (faseC) {
      sensorData.phase3.voltage = faseC["v"];
      sensorData.phase3.current = faseC["c"];
      sensorData.phase3.power = faseC["p"];
      sensorData.phase3.energy = faseC["e"];
      sensorData.phase3.powerFactor = faseC["pf"];
    }
    
    sensorData.lastUpdate = millis();
    needsRefresh = true;
    Serial.println("Data updated from MQTT");
  } else {
    Serial.print("JSON parsing error: ");
    Serial.println(error.c_str());
  }
}

void reconnect() {
  int attempts = 0;
  while (!client.connected() && attempts < 3) {  // Limit reconnection attempts
    attempts++;
    Serial.print("Attempting MQTT connection... ");
    String clientId = "ESP32Client-";
    clientId += String(random(0xffff), HEX);
    
    if (client.connect(clientId.c_str(), MQTT_USERNAME, MQTT_PASSWORD)) {
      Serial.println("connected");
      client.subscribe(MQTT_TOPIC);
    } else {
      Serial.print("failed, rc=");
      Serial.print(client.state());
      Serial.println(" retrying in 5 seconds");
      delay(5000);
    }
  }
}

void drawLayout() {
  tft.fillScreen(COLOR_BACKGROUND);
  drawHeader();
}

// Versão otimizada do drawHeader
void drawHeader() {
  // Limpar a área do cabeçalho
  tft.fillRect(0, 0, tft.width(), 55, COLOR_BACKGROUND);
  
  // PowerGard Monitor no topo
  tft.setTextColor(COLOR_GAS_ALARM_BG, COLOR_BACKGROUND);
  tft.drawString("PowerGard Monitor", 10, 10, 2);
  
  // Status MQTT
  if (client.connected()) {
    tft.setTextColor(COLOR_VOLTAGE, COLOR_BACKGROUND);
    tft.drawString("MQTT: OK", tft.width() - 80, 10, 2);
  } else {
    tft.setTextColor(COLOR_WARNING, COLOR_BACKGROUND);
    tft.drawString("MQTT: NC", tft.width() - 80, 10, 2);
  }
  
  // Linha separadora
  tft.drawFastHLine(0, 30, tft.width(), COLOR_TITLE);
  
  // Mostra a hora
  tft.setTextColor(COLOR_TEXT, COLOR_BACKGROUND);
  tft.drawString(sensorData.timeStr, 10, 35, 2);
  
  // Indicador de força do sinal WiFi com barras
  int rssi = WiFi.RSSI();
  tft.drawString("WiFi:", tft.width() - 100, 35, 2);
  
  // Posição das barras
  int barX = tft.width() - 50;
  int barY = 37;
  int barWidth = 3;  // Largura de cada barra
  int barGap = 2;    // Espaço entre as barras
  int maxBars = 5;   // Número total de barras
  
  // Determina quantas barras mostrar baseado no RSSI
  int activeBars;
  if (rssi >= -50) activeBars = 5;      // -50 dBm ou melhor (Excelente)
  else if (rssi >= -60) activeBars = 4;  // -60 dBm (Muito Bom)
  else if (rssi >= -70) activeBars = 3;  // -70 dBm (Bom)
  else if (rssi >= -80) activeBars = 2;  // -80 dBm (Regular)
  else activeBars = 1;                   // Pior que -80 dBm (Fraco)
  
  // Desenha as barras
  for (int i = 0; i < maxBars; i++) {
    int barHeight = 4 + (i * 2);  // Cada barra fica um pouco mais alta
    int currentBarY = barY + (12 - barHeight);  // Alinha as barras na parte inferior
    
    // Desenha barra ativa ou inativa
    if (i < activeBars) {
      tft.fillRect(barX + (i * (barWidth + barGap)), currentBarY, barWidth, barHeight, COLOR_VOLTAGE);
    } else {
      tft.fillRect(barX + (i * (barWidth + barGap)), currentBarY, barWidth, barHeight, COLOR_INACTIVE);
    }
  }
  
  // Linha separadora após o tempo e WiFi
  tft.drawFastHLine(0, 55, tft.width(), COLOR_TITLE);
}

// Versão otimizada do updateDisplay
void updateDisplay() {
  // Desenha o cabeçalho
  drawHeader();
  
  // Limpa a área de conteúdo
  tft.fillRect(0, 56, tft.width(), tft.height() - 56, COLOR_BACKGROUND);
  
  // Se o alarme estiver ativo, mostra a página de alarme apropriada
  if (alarmActive && activeAlarmPage >= 0) {
    switch (activeAlarmPage) {
      case 0: // Alarme de perda de fase
        drawPhaseFailAlarmPage();
        break;
      case 1: // Alarme de tensão
        drawVoltageAlarmPage();
        break;
      case 2: // Alarme de gás
        drawGasAlarmPage();
        break;
    }
  } else {
    // Mostra páginas regulares
    switch(currentPage) {
      case 0:
        drawPage1(); // Dados da Fase 1
        break;
      case 1:
        drawPage2(); // Dados da Fase 2
        break;
      case 2:
        drawPage3(); // Dados da Fase 3
        break;
      case 3:
        drawPage4(); // Status do sistema
        break;
      case 4:
        drawPage5(); // Página de resumo
        break;
    }
    
    // Desenha o indicador de página
    drawPageIndicator();
  }
}

// Alarme de tensão
void drawVoltageAlarmPage() {
  // Fundo vermelho para alarme
  tft.fillRect(0, 56, tft.width(), tft.height() - 56, COLOR_ALARM_BG);
  
  int yPos = 90;
  
  // Texto grande para alarme
  tft.setTextColor(COLOR_VOLTAGE, COLOR_ALARM_BG);
  tft.setTextSize(3);
  tft.setCursor(20, yPos);
  tft.println("TENSAO");
  yPos += 36;
  tft.setCursor(20, yPos);
  tft.println("ANORMAL");
  tft.setTextSize(1);  // Reset text size for next drawing
  yPos += 50;
  
  // Mostra quais fases têm problemas de tensão
  tft.setTextColor(COLOR_TEXT, COLOR_ALARM_BG);
  tft.setTextSize(2);
  
  if (alarmStates.voltageInfo.phase1High) {
    tft.setCursor(10, yPos);
    tft.print("Fase 1: ");
    tft.print(sensorData.phase1.voltage, 1);
    tft.println("V (ALTA)");
    yPos += 30;
  } else if (alarmStates.voltageInfo.phase1Low) {
    tft.setCursor(10, yPos);
    tft.print("Fase 1: ");
    tft.print(sensorData.phase1.voltage, 1);
    tft.println("V (BAIXA)");
    yPos += 30;
  }
  
  if (alarmStates.voltageInfo.phase2High) {
    tft.setCursor(10, yPos);
    tft.print("Fase 2: ");
    tft.print(sensorData.phase2.voltage, 1);
    tft.println("V (ALTA)");
    yPos += 30;
  } else if (alarmStates.voltageInfo.phase2Low) {
    tft.setCursor(10, yPos);
    tft.print("Fase 2: ");
    tft.print(sensorData.phase2.voltage, 1);
    tft.println("V (BAIXA)");
    yPos += 30;
  }
  
  if (alarmStates.voltageInfo.phase3High) {
    tft.setCursor(10, yPos);
    tft.print("Fase 3: ");
    tft.print(sensorData.phase3.voltage, 1);
    tft.println("V (ALTA)");
    yPos += 30;
  } else if (alarmStates.voltageInfo.phase3Low) {
    tft.setCursor(10, yPos);
    tft.print("Fase 3: ");
    tft.print(sensorData.phase3.voltage, 1);
    tft.println("V (BAIXA)");
    yPos += 30;
  }
  
  // Reset text size
  tft.setTextSize(1);
  
  // Press any button to acknowledge message
  yPos = tft.height() - 30;
  tft.setTextColor(COLOR_TEXT, COLOR_ALARM_BG);
  tft.drawString("Pressione qualquer botao", 30, yPos, 2);
}

// Alarme de falha de fase
void drawPhaseFailAlarmPage() {
  // Fundo vermelho para alarme
  tft.fillRect(0, 56, tft.width(), tft.height() - 56, COLOR_ALARM_BG);
  
  int yPos = 90;
  
  // Texto grande para alarme
  tft.setTextColor(COLOR_TEXT, COLOR_ALARM_BG);
  tft.setTextSize(3);
  tft.setCursor(20, yPos);
  tft.println("FALHA");
  yPos += 40;
  tft.setCursor(20, yPos);
  tft.println("DE FASE");
  tft.setTextSize(1);  // Reset text size for next drawing
  yPos += 40;
  
  // Mostra quais fases falharam
  tft.setTextColor(COLOR_TEXT, COLOR_ALARM_BG);
  tft.setTextSize(2);
  
  tft.setCursor(10, yPos);
  tft.print("Fases ausentes: ");
  yPos += 30;
  
  if (alarmStates.phaseInfo.phase1Loss) {
    tft.setCursor(40, yPos);
    tft.println("Fase 1");
    yPos += 25;
  }
  
  if (alarmStates.phaseInfo.phase2Loss) {
    tft.setCursor(40, yPos);
    tft.println("Fase 2");
    yPos += 25;
  }
  
  if (alarmStates.phaseInfo.phase3Loss) {
    tft.setCursor(40, yPos);
    tft.println("Fase 3");
    yPos += 25;
  }
  
  // Reset text size
  tft.setTextSize(1);
  
  // Press any button to acknowledge message
  yPos = tft.height() - 30;
  tft.setTextColor(COLOR_TEXT, COLOR_ALARM_BG);
  tft.drawString("Pressione qualquer botao", 30, yPos, 2);
}

// Alarme de gás
void drawGasAlarmPage() {
  // Fundo verde para alarme de gás
  tft.fillRect(0, 56, tft.width(), tft.height() - 56, COLOR_GAS_ALARM_BG);
  
  int yPos = 90;
  
  // Texto grande para alarme
  tft.setTextColor(COLOR_INACTIVE, COLOR_GAS_ALARM_BG);
  tft.setTextSize(3);
  tft.setCursor(20, yPos);
  tft.println("PERIGO:");
  yPos += 40;
  tft.setCursor(20, yPos);
  tft.println("Vazamento");
  yPos += 40;
  tft.setCursor(20, yPos);
  tft.println("de Gas");
  tft.setTextSize(1);  // Reset text size for next drawing
  yPos += 60;
  
  // Mostra nível de gás
  tft.setTextColor(COLOR_INACTIVE, COLOR_GAS_ALARM_BG);
  tft.setTextSize(2);
  tft.setCursor(20, yPos);
  tft.print("Nivel: ");
  tft.print(sensorData.gasmon);
  tft.println(" ppm");
  yPos += 30;
  
  // Instrução de segurança
  tft.setCursor(20, yPos);
  tft.println("Evacue a area!");
  
  // Reset text size
  tft.setTextSize(1);
  
  // Press any button to acknowledge message
  yPos = tft.height() - 30;
  tft.setTextColor(COLOR_INACTIVE, COLOR_GAS_ALARM_BG);
  tft.drawString("Pressione qualquer botao", 30, yPos, 2);
}

// Página 1 - Fase 1
void drawPage1() {
  int yPos = 65;
  
  // Título da página
  tft.setTextColor(COLOR_SUBTITLE, COLOR_BACKGROUND);
  tft.drawString("FASE 1 - Medidas", 10, yPos, 2);
  yPos += 25;
  
  // Medidas da Fase 1
  tft.setTextColor(COLOR_TEXT, COLOR_BACKGROUND);
  
  // Tensão
  tft.drawString("Tensao:", 10, yPos, 2);
  tft.setTextColor(COLOR_VOLTAGE, COLOR_BACKGROUND);
  tft.drawFloat(sensorData.phase1.voltage, 1, 100, yPos, 2);
  tft.setTextColor(COLOR_TEXT, COLOR_BACKGROUND);
  tft.drawString("VAC", 170, yPos, 2);
  yPos += 25;
  
  // Corrente
  tft.drawString("Corrente:", 10, yPos, 2);
  tft.setTextColor(COLOR_VOLTAGE, COLOR_BACKGROUND);
  tft.drawFloat(sensorData.phase1.current, 1, 100, yPos, 2);
  tft.setTextColor(COLOR_TEXT, COLOR_BACKGROUND);
  tft.drawString("A", 170, yPos, 2);
  yPos += 25;
  
  // Potência
  tft.drawString("Potência:", 10, yPos, 2);
  tft.setTextColor(COLOR_VOLTAGE, COLOR_BACKGROUND);
  tft.drawFloat(sensorData.phase1.power, 1, 100, yPos, 2);
  tft.setTextColor(COLOR_TEXT, COLOR_BACKGROUND);
  tft.drawString("W", 170, yPos, 2);
  yPos += 25;
  
  // Energia
  tft.drawString("Energia:", 10, yPos, 2);
  tft.setTextColor(COLOR_VOLTAGE, COLOR_BACKGROUND);
  tft.drawFloat(sensorData.phase1.energy, 1, 100, yPos, 2);
  tft.setTextColor(COLOR_TEXT, COLOR_BACKGROUND);
  tft.drawString("kWh", 170, yPos, 2);
  yPos += 25;
  
  // Fator de potência
  tft.drawString("Fator de Pot.:", 10, yPos, 2);
  tft.setTextColor(COLOR_VOLTAGE, COLOR_BACKGROUND);
  tft.drawFloat(sensorData.phase1.powerFactor, 2, 100, yPos, 2);
  yPos += 45;
  
  // Gráfico de barras de tensão
  tft.setTextColor(COLOR_TEXT, COLOR_BACKGROUND);
  tft.drawString("Nivel de Tensao:", 10, yPos, 2);
  yPos += 20;
  
  // Determina a cor com base no valor da tensão
  uint16_t barColor;
  if (sensorData.phase1.voltage < 95 || sensorData.phase1.voltage > 135) {
    barColor = COLOR_WARNING;  // Vermelho para valores fora da faixa ideal
  } else {
    barColor = COLOR_VOLTAGE;  // Amarelo para valores normais
  }
  
  // Calcula a largura da barra com base na tensão (faixa 0-250V)
  int barWidth = map(sensorData.phase1.voltage, 0, 250, 0, tft.width() - 20);
  
  // Fundo da barra
  tft.fillRect(10, yPos, tft.width() - 20, 15, COLOR_BAR_BG);
  // Barra de progresso
  tft.fillRect(10, yPos, barWidth, 15, barColor);
  // Borda
  tft.drawRect(10, yPos, tft.width() - 20, 15, COLOR_TEXT);
}

// Página 2 - Fase 2
void drawPage2() {
  int yPos = 65;
  
  // Título da página
  tft.setTextColor(COLOR_SUBTITLE, COLOR_BACKGROUND);
  tft.drawString("FASE 2 - Medidas", 10, yPos, 2);
  yPos += 25;
  
  // Medidas da Fase 2
  tft.setTextColor(COLOR_TEXT, COLOR_BACKGROUND);
  
  // Tensão
  tft.drawString("Tensão:", 10, yPos, 2);
  tft.setTextColor(COLOR_VOLTAGE, COLOR_BACKGROUND);
  tft.drawFloat(sensorData.phase2.voltage, 1, 100, yPos, 2);
  tft.setTextColor(COLOR_TEXT, COLOR_BACKGROUND);
  tft.drawString("VAC", 170, yPos, 2);
  yPos += 25;
  
  // Corrente
  tft.drawString("Corrente:", 10, yPos, 2);
  tft.setTextColor(COLOR_VOLTAGE, COLOR_BACKGROUND);
  tft.drawFloat(sensorData.phase2.current, 1, 100, yPos, 2);
  tft.setTextColor(COLOR_TEXT, COLOR_BACKGROUND);
  tft.drawString("A", 170, yPos, 2);
  yPos += 25;
  
  // Potência
  tft.drawString("Potência:", 10, yPos, 2);
  tft.setTextColor(COLOR_VOLTAGE, COLOR_BACKGROUND);
  tft.drawFloat(sensorData.phase2.power, 1, 100, yPos, 2);
  tft.setTextColor(COLOR_TEXT, COLOR_BACKGROUND);
  tft.drawString("W", 170, yPos, 2);
  yPos += 25;
  
  // Energia
  tft.drawString("Energia:", 10, yPos, 2);
  tft.setTextColor(COLOR_VOLTAGE, COLOR_BACKGROUND);
  tft.drawFloat(sensorData.phase2.energy, 1, 100, yPos, 2);
  tft.setTextColor(COLOR_TEXT, COLOR_BACKGROUND);
  tft.drawString("kWh", 170, yPos, 2);
  yPos += 25;
  
  // Fator de potência
  tft.drawString("Fator de Pot.:", 10, yPos, 2);
  tft.setTextColor(COLOR_VOLTAGE, COLOR_BACKGROUND);
  tft.drawFloat(sensorData.phase2.powerFactor, 2, 100, yPos, 2);
  yPos += 45;
  
  // Gráfico de barras de tensão
  tft.setTextColor(COLOR_TEXT, COLOR_BACKGROUND);
  tft.drawString("Nivel de Tensão:", 10, yPos, 2);
  yPos += 20;
  
  // Determina a cor com base no valor da tensão
  uint16_t barColor;
  if (sensorData.phase2.voltage < 95 || sensorData.phase2.voltage > 135) {
    barColor = COLOR_WARNING;  // Vermelho para valores fora da faixa ideal
  } else {
    barColor = COLOR_VOLTAGE;  // Amarelo para valores normais
  }
  
  // Calcula a largura da barra com base na tensão (faixa 0-250V)
  int barWidth = map(sensorData.phase2.voltage, 0, 250, 0, tft.width() - 20);
  
  // Fundo da barra
  tft.fillRect(10, yPos, tft.width() - 20, 15, COLOR_BAR_BG);
  // Barra de progresso
  tft.fillRect(10, yPos, barWidth, 15, barColor);
  // Borda
  tft.drawRect(10, yPos, tft.width() - 20, 15, COLOR_TEXT);
}

// Página 3 - Fase 3
void drawPage3() {
  int yPos = 65;
  
  // Título da página
  tft.setTextColor(COLOR_SUBTITLE, COLOR_BACKGROUND);
  tft.drawString("FASE 3 - Medidas", 10, yPos, 2);
  yPos += 25;
  
  // Medidas da Fase 3
  tft.setTextColor(COLOR_TEXT, COLOR_BACKGROUND);
  
  // Tensão
  tft.drawString("Tensão:", 10, yPos, 2);
  tft.setTextColor(COLOR_VOLTAGE, COLOR_BACKGROUND);
  tft.drawFloat(sensorData.phase3.voltage, 1, 100, yPos, 2);
  tft.setTextColor(COLOR_TEXT, COLOR_BACKGROUND);
  tft.drawString("VAC", 160, yPos, 2);
  yPos += 25;
  
  // Corrente
  tft.drawString("Corrente:", 10, yPos, 2);
  tft.setTextColor(COLOR_VOLTAGE, COLOR_BACKGROUND);
  tft.drawFloat(sensorData.phase3.current, 1, 100, yPos, 2);
  tft.setTextColor(COLOR_TEXT, COLOR_BACKGROUND);
  tft.drawString("A", 160, yPos, 2);
  yPos += 25;
  
  // Potência
  tft.drawString("Potência:", 10, yPos, 2);
  tft.setTextColor(COLOR_VOLTAGE, COLOR_BACKGROUND);
  tft.drawFloat(sensorData.phase3.power, 1, 100, yPos, 2);
  tft.setTextColor(COLOR_TEXT, COLOR_BACKGROUND);
  tft.drawString("W", 170, yPos, 2);
  yPos += 25;
  
  // Energia
  tft.drawString("Energia:", 10, yPos, 2);
  tft.setTextColor(COLOR_VOLTAGE, COLOR_BACKGROUND);
  tft.drawFloat(sensorData.phase3.energy, 1, 100, yPos, 2);
  tft.setTextColor(COLOR_TEXT, COLOR_BACKGROUND);
  tft.drawString("kWh", 170, yPos, 2);
  yPos += 25;
  
  // Fator de potência
  tft.drawString("Fator de Pot.:", 10, yPos, 2);
  tft.setTextColor(COLOR_VOLTAGE, COLOR_BACKGROUND);
  tft.drawFloat(sensorData.phase3.powerFactor, 2, 100, yPos, 2);
  yPos += 45;
  
  // Gráfico de barras de tensão
  tft.setTextColor(COLOR_TEXT, COLOR_BACKGROUND);
  tft.drawString("Nivel de Tensão:", 10, yPos, 2);
  yPos += 20;
  
  // Determina a cor com base no valor da tensão
  uint16_t barColor;
  if (sensorData.phase3.voltage < 95 || sensorData.phase3.voltage > 135) {
    barColor = COLOR_WARNING;  // Vermelho para valores fora da faixa ideal
  } else {
    barColor = COLOR_VOLTAGE;  // Amarelo para valores normais
  }
  
  // Calcula a largura da barra com base na tensão (faixa 0-250V)
  int barWidth = map(sensorData.phase3.voltage, 0, 250, 0, tft.width() - 20);
  
  // Fundo da barra
  tft.fillRect(10, yPos, tft.width() - 20, 15, COLOR_BAR_BG);
  // Barra de progresso
  tft.fillRect(10, yPos, barWidth, 15, barColor);
  // Borda
  tft.drawRect(10, yPos, tft.width() - 20, 15, COLOR_TEXT);
}

// Página 4 - Status do Sistema
void drawPage4() {
  int yPos = 65;
  
  // Título da página
  tft.setTextColor(COLOR_SUBTITLE, COLOR_BACKGROUND);
  tft.drawString("Status do Sistema", 10, yPos, 2);
  yPos += 20;
  
  // Nível de gás com barra
  tft.setTextColor(COLOR_TEXT, COLOR_BACKGROUND);
  tft.drawString("Nivel de Gas:", 10, yPos, 2);
  tft.drawFloat(sensorData.gasmon, 0, 150, yPos, 2);
  tft.drawString("ppm", 200, yPos, 2);
  yPos += 20;
  
  int gasBarWidth = map(sensorData.gasmon, 0, 100, 0, tft.width() - 20);
  // Fundo da barra
  tft.fillRect(10, yPos, tft.width() - 20, 15, COLOR_BAR_BG);
  // Barra de progresso
  tft.fillRect(10, yPos, gasBarWidth, 15, 
               sensorData.gasmon > 7 ? COLOR_WARNING : COLOR_OK);
  // Borda
  tft.drawRect(10, yPos, tft.width() - 20, 15, COLOR_TEXT);
  yPos += 30;
  
  // Nível de água com barra
  tft.setTextColor(COLOR_TEXT, COLOR_BACKGROUND);
  tft.drawString("Nivel de Agua:", 10, yPos, 2);
  tft.drawNumber(sensorData.levCx1, 150, yPos, 2);
  tft.drawString("%", 180, yPos, 2);
  yPos += 20;
  
  int waterLevelBarWidth = map(sensorData.levCx1, 0, 100, 0, tft.width() - 20);
  // Fundo da barra
  tft.fillRect(10, yPos, tft.width() - 20, 15, COLOR_BAR_BG);
  // Barra de progresso
  tft.fillRect(10, yPos, waterLevelBarWidth, 15, 
               sensorData.levCx1 < 20 ? COLOR_WARNING : COLOR_OK);
  // Borda
  tft.drawRect(10, yPos, tft.width() - 20, 15, COLOR_TEXT);
  yPos += 30;
  
  // Fluxo de água com barra
  tft.setTextColor(COLOR_TEXT, COLOR_BACKGROUND);
  tft.drawString("Fluxo de Agua:", 10, yPos, 2);
  tft.drawNumber(sensorData.levCx2, 150, yPos, 2);
  tft.drawString("L/min", 180, yPos, 2);
  yPos += 20;
  
  int waterFlowBarWidth = map(sensorData.levCx2, 0, 100, 0, tft.width() - 20);
  // Fundo da barra
  tft.fillRect(10, yPos, tft.width() - 20, 15, COLOR_BAR_BG);
  // Barra de progresso
  tft.fillRect(10, yPos, waterFlowBarWidth, 15, COLOR_OK);
  // Borda
  tft.drawRect(10, yPos, tft.width() - 20, 15, COLOR_TEXT);
  yPos += 10;
  
  // Indicadores de status do sistema
  tft.drawFastHLine(0, yPos, tft.width(), COLOR_INACTIVE);
  yPos += 10;
  
  // Indicadores de status com círculos
  tft.setTextColor(sensorData.overSub ? COLOR_OK : COLOR_WARNING, COLOR_BACKGROUND);
  tft.drawString("Tensao: " + String(sensorData.overSub ? "NORMAL  " : "ANOMALIA"), 10, yPos, 2);
  tft.fillCircle(tft.width() - 20, yPos + 8, 5, sensorData.overSub ? COLOR_OK : COLOR_WARNING);
  yPos += 25;
  
  tft.setTextColor(sensorData.faseStatus ? COLOR_OK : COLOR_WARNING, COLOR_BACKGROUND);
  tft.drawString("Fases: " + String(sensorData.faseStatus ? "NORMAL " : "FALHA"), 10, yPos, 2);
  tft.fillCircle(tft.width() - 20, yPos + 8, 5, sensorData.faseStatus ? COLOR_OK : COLOR_WARNING);
  yPos += 25;
  
  tft.setTextColor(sensorData.activeStatus ? COLOR_OK : COLOR_WARNING, COLOR_BACKGROUND);
  tft.drawString("Sistema: " + String(sensorData.activeStatus ? "ATIVO  " : "INATIVO"), 10, yPos, 2);
  tft.fillCircle(tft.width() - 20, yPos + 8, 5, sensorData.activeStatus ? COLOR_OK : COLOR_WARNING);
}

// Página 5 - Resumo
void drawPage5() {
  int yPos = 65;
  
  // Título da página
  tft.setTextColor(COLOR_SUBTITLE, COLOR_BACKGROUND);
  tft.drawString("Resumo do Sistema", 10, yPos, 2);
  yPos += 25;
  
  // Resumo de informações das fases
  // Posições iniciais bem definidas com espaçamento adequado
  int xPosF = 10;    // Posição do "F1:", "F2:", "F3:"
  int xPosV = 35;    // Posição da tensão
  int xPosA = 85;    // Posição da corrente
  int xPosKW = 135;  // Posição da energia
  int xPosPF = 195;  // Posição do fator de potência
  
  // ===== FASE 1 =====
  tft.setTextColor(COLOR_TEXT, COLOR_BACKGROUND);
  tft.drawString("F1:", xPosF, yPos, 2);
  
  // Tensão com "V" logo depois
  tft.setTextColor(COLOR_VOLTAGE, COLOR_BACKGROUND);
  int tensaoWidth = tft.drawFloat(sensorData.phase1.voltage, 0, xPosV, yPos, 2);
  tft.drawString("V", xPosV + tensaoWidth, yPos, 2);
  
  // Corrente com "A" logo depois
  int correnteWidth = tft.drawFloat(sensorData.phase1.current, 1, xPosA, yPos, 2);
  tft.drawString("A", xPosA + correnteWidth, yPos, 2);
  
  // "kW" antes do valor da energia, com ajuste para não sobrepor
  int posKW = xPosKW;
  tft.drawString("kW", posKW, yPos, 2);
  tft.drawFloat(sensorData.phase1.energy, 0, posKW + 22, yPos, 2);
  
  // Fator de potência com posição fixa mais à direita
  tft.drawString("PF:", xPosPF, yPos, 2);
  tft.drawFloat(sensorData.phase1.powerFactor, 2, xPosPF + 25, yPos, 2);
  yPos += 20;
  
  // ===== FASE 2 =====
  tft.setTextColor(COLOR_TEXT, COLOR_BACKGROUND);
  tft.drawString("F2:", xPosF, yPos, 2);
  
  // Tensão com "V" logo depois
  tft.setTextColor(COLOR_VOLTAGE, COLOR_BACKGROUND);
  tensaoWidth = tft.drawFloat(sensorData.phase2.voltage, 0, xPosV, yPos, 2);
  tft.drawString("V", xPosV + tensaoWidth, yPos, 2);
  
  // Corrente com "A" logo depois
  correnteWidth = tft.drawFloat(sensorData.phase2.current, 1, xPosA, yPos, 2);
  tft.drawString("A", xPosA + correnteWidth, yPos, 2);
  
  // "kW" antes do valor da energia
  tft.drawString("kW", posKW, yPos, 2);
  tft.drawFloat(sensorData.phase2.energy, 0, posKW + 22, yPos, 2);
  
  // Fator de potência
  tft.drawString("PF:", xPosPF, yPos, 2);
  tft.drawFloat(sensorData.phase2.powerFactor, 2, xPosPF + 25, yPos, 2);
  yPos += 20;
  
  // ===== FASE 3 =====
  tft.setTextColor(COLOR_TEXT, COLOR_BACKGROUND);
  tft.drawString("F3:", xPosF, yPos, 2);
  
  // Tensão com "V" logo depois
  tft.setTextColor(COLOR_VOLTAGE, COLOR_BACKGROUND);
  tensaoWidth = tft.drawFloat(sensorData.phase3.voltage, 0, xPosV, yPos, 2);
  tft.drawString("V", xPosV + tensaoWidth, yPos, 2);
  
  // Corrente com "A" logo depois
  correnteWidth = tft.drawFloat(sensorData.phase3.current, 1, xPosA, yPos, 2);
  tft.drawString("A", xPosA + correnteWidth, yPos, 2);
  
  // "kW" antes do valor da energia
  tft.drawString("kW", posKW, yPos, 2);
  tft.drawFloat(sensorData.phase3.energy, 0, posKW + 22, yPos, 2);
  
  // Fator de potência
  tft.drawString("PF:", xPosPF, yPos, 2);
  tft.drawFloat(sensorData.phase3.powerFactor, 2, xPosPF + 25, yPos, 2);
  yPos += 30;
  
  // Divisor horizontal
  tft.drawFastHLine(10, yPos, tft.width() - 20, COLOR_INACTIVE);
  yPos += 15;
  
  // Nível de gás
  tft.setTextColor(COLOR_TEXT, COLOR_BACKGROUND);
  tft.drawString("Gas Level:", 10, yPos, 2);
  tft.setTextColor(
    sensorData.gasmon > 7 ? COLOR_WARNING : COLOR_OK,
    COLOR_BACKGROUND
  );
  tft.drawFloat(sensorData.gasmon, 0, 120, yPos, 2);
  tft.drawString("ppm", 160, yPos, 2);
  yPos += 20;
  
  // Fluxo de água
  tft.setTextColor(COLOR_TEXT, COLOR_BACKGROUND);
  tft.drawString("Water Flow:", 10, yPos, 2);
  tft.setTextColor(COLOR_OK, COLOR_BACKGROUND);
  tft.drawFloat(sensorData.levCx2, 0, 120, yPos, 2);
  tft.drawString("L/min", 160, yPos, 2);
  yPos += 20;
  
  // Nível de água
  tft.setTextColor(COLOR_TEXT, COLOR_BACKGROUND);
  tft.drawString("Water Level:", 10, yPos, 2);
  tft.setTextColor(
    sensorData.levCx1 < 20 ? COLOR_WARNING : COLOR_OK,
    COLOR_BACKGROUND
  );
  tft.drawFloat(sensorData.levCx1, 0, 120, yPos, 2);
  tft.drawString("%", 160, yPos, 2);
  yPos += 30;
  
  // Status do sistema com código de cores
  tft.drawFastHLine(10, yPos, tft.width() - 20, COLOR_INACTIVE);
  yPos += 15;
  
  // Indicador de status do sistema
  tft.setTextColor(COLOR_TEXT, COLOR_BACKGROUND);
  tft.drawString("Status:", 10, yPos, 2);
  
  if (sensorData.activeStatus) {
    tft.setTextColor(COLOR_OK, COLOR_BACKGROUND);
    tft.drawString("SYSTEM ON", 120, yPos, 2);
    tft.fillCircle(210, yPos + 7, 7, COLOR_OK);
  } else {
    tft.setTextColor(COLOR_WARNING, COLOR_BACKGROUND);
    tft.drawString("SYSTEM OFF", 120, yPos, 2);
    tft.fillCircle(210, yPos + 7, 7, COLOR_WARNING);
  }
}

// Desenha o indicador de página na parte inferior
void drawPageIndicator() {
  // Coordenadas Y absolutas na tela
  int indicatorY = tft.height() - 15;
  
  // Limpa a área do indicador de página
  tft.fillRect(0, tft.height() - 25, tft.width(), 25, COLOR_BACKGROUND);
  
  int dotSize = 5;
  int dotSpacing = 15;
  int startX = (tft.width() - ((TOTAL_PAGES - 1) * dotSpacing + dotSize)) / 2;
  
  for (int i = 0; i < TOTAL_PAGES; i++) {
    if (i == currentPage) {
      tft.fillCircle(startX + i * dotSpacing, indicatorY, dotSize, COLOR_TITLE);
    } else {
      tft.drawCircle(startX + i * dotSpacing, indicatorY, dotSize, COLOR_TEXT);
    }
  }
  
  // Adiciona setas de navegação
  tft.fillTriangle(10, indicatorY, 5, indicatorY - 5, 5, indicatorY + 5, COLOR_TEXT); // Seta esquerda
  tft.fillTriangle(tft.width() - 10, indicatorY, tft.width() - 5, indicatorY - 5, tft.width() - 5, indicatorY + 5, COLOR_TEXT); // Seta direita
}

// Atualiza hora e WiFi
void updateTimeAndWifi() {
  struct tm timeinfo;
  if (getLocalTime(&timeinfo)) {
    strftime(sensorData.timeStr, sizeof(sensorData.timeStr), "%H:%M:%S", &timeinfo);
  }
  
  sensorData.wifiStrength = WiFi.RSSI();
}

// Desenha borda
void drawBorder() {
  tft.drawRect(0, 0, tft.width(), tft.height(), COLOR_TITLE);
}
